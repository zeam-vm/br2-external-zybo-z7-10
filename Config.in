## configs/zybo_z7_10_defconfig
```kconfig
BR2_arm=y
BR2_cortex_a9=y
BR2_ARM_ENABLE_NEON=y
BR2_ARM_ENABLE_VFP=y
BR2_ARM_FPU_NEON=y
BR2_KERNEL_HEADERS_5_15=y
BR2_ROOTFS_POST_IMAGE_SCRIPT="${BR2_EXTERNAL_ZYBO_Z7_10_PATH}/board/post-createfs.sh"
BR2_ROOTFS_POST_SCRIPT_ARGS="${BR2_EXTERNAL_ZYBO_Z7_10_PATH}/board/fwup.conf"
BR2_LINUX_KERNEL=y
BR2_LINUX_KERNEL_CUSTOM_GIT=y
BR2_LINUX_KERNEL_CUSTOM_REPO_URL="https://github.com/Digilent/linux-digilent.git"
BR2_LINUX_KERNEL_CUSTOM_REPO_VERSION="digilent_rebase_v5.15_LTS_2022.1"
BR2_LINUX_KERNEL_DEFCONFIG="xilinx_zynq"
BR2_TARGET_ROOTFS_EXT2=y
BR2_TARGET_ROOTFS_EXT2_4=y
BR2_TARGET_UBOOT=y
BR2_TARGET_UBOOT_BUILD_SYSTEM_KCONFIG=y
BR2_TARGET_UBOOT_CUSTOM_GIT=y
BR2_TARGET_UBOOT_CUSTOM_REPO_URL="https://github.com/Digilent/u-boot-digilent.git"
BR2_TARGET_UBOOT_CUSTOM_REPO_VERSION="digilent_rebase_v2022.01"
BR2_TARGET_UBOOT_BOARD_DEFCONFIG="xilinx_zynq_virt"
# BR2_TARGET_UBOOT_FORMAT_BIN is not set
BR2_TARGET_UBOOT_FORMAT_REMAKE_ELF=y
BR2_PACKAGE_HOST_BOOTGEN=y
BR2_PACKAGE_HOST_FWUP=y
```

## package/zynq_fsbl/Config.in
```kconfig
config BR2_PACKAGE_ZYNQ_FSBL
	bool "zynq_fsbl"
	help
	  build Zynq FSBL.

	  url: https://github.com/Xilinx/embeddedsw
	  path: /lib/sw_apps/zynq_fsbl/misc/Readme.txt
```
